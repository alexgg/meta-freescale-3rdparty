## conf/machine/ccimx6sbc.conf
```bitbake
#@TYPE: Machine
#@NAME: ConnectCore 6 SBC
#@SOC: i.MX6 Q/DL
#@DESCRIPTION: Machine configuration for ConnectCore 6 SBC board.
#@MAINTAINER: Alex Gonzalez <alex.gonzalez@digi.com>

MACHINEOVERRIDES =. "mx6:mx6q:ccimx6:"

include conf/machine/include/imx-base.inc
include conf/machine/include/tune-cortexa9.inc

PREFERRED_PROVIDER_virtual/bootloader = "u-boot-digi"
PREFERRED_PROVIDER_u-boot = "u-boot-digi"
PREFERRED_PROVIDER_virtual/kernel ??= "linux-mainline"

UBOOT_BOOTSCRIPT = "boot.scr"

UBOOT_CONFIG ??= "ccimx6dlsbc512MB ccimx6dlsbc ccimx6qsbc2GB ccimx6qsbc512MB ccimx6qsbc"
UBOOT_CONFIG[ccimx6dlsbc512MB] = "ccimx6dlsbc512MB_defconfig"
UBOOT_CONFIG[ccimx6dlsbc] = "ccimx6dlsbc_defconfig"
UBOOT_CONFIG[ccimx6qsbc2GB] = "ccimx6qsbc2GB_defconfig"
UBOOT_CONFIG[ccimx6qsbc512MB] = "ccimx6qsbc512MB_defconfig"
UBOOT_CONFIG[ccimx6qsbc] = "ccimx6qsbc_defconfig"

IMAGE_CLASSES += "image_types_digi"

SERIAL_CONSOLES = "115200;ttymxc3"

KERNEL_DEVICETREE ?= " \
    imx6q-ccimx6sbc.dtb \
"

MACHINE_EXTRA_RDEPENDS += " \
    e2fsprogs-mke2fs \
    e2fsprogs-resize2fs \
"

INITRAMFS_IMAGE_BUNDLE = "1"
INITRAMFS_IMAGE = "core-image-boot-initramfs"

IMAGE_FSTYPES += "boot.vfat ext4 tar.bz2"
```
